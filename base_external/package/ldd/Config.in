## base_external/package/ldd/Config.in
```kconfig
config BR2_PACKAGE_LDD
	bool "ldd"
	depends on BR2_LINUX_KERNEL
	help
	  Includes the misc-modules and scull components into the root filesystem and adds them in the kernel image.
	  Used to understand buildroot external trees and package builds.
```
